## boards/eyelashperipherals/eyelash_sofle/board.yml
```yaml
boards:
  - name: eyelash_sofle_left
    vendor: eyelashperipherals
    socs:
      - name: nrf52840
        variants:
          - name: zmk
  - name: eyelash_sofle_right
    vendor: eyelashperipherals
    socs:
      - name: nrf52840
        variants:
          - name: zmk
```

## config/west.yml
```yaml
manifest:
  remotes:
    - name: zmkfirmware
      url-base: https://github.com/zmkfirmware
    - name: badjeff
      url-base: https://github.com/badjeff
  projects:
    - name: zmk
      remote: zmkfirmware
      revision: v0.3.0
      import: app/west.yml
    - name: zmk-analog-input-driver
      remote: badjeff
      revision: main
  self:
    path: boards
```
